## config/west.yml
```yaml
manifest:
  remotes:
    - name: zmkfirmware
      url-base: https://github.com/zmkfirmware
    - name: mouse-pr-remote
      url-base: https://github.com/krikun98/
  projects:
    - name: zmk
      remote: mouse-pr-remote
      revision: mouse-pr
      import: app/west.yml
  self:
    path: config
```
